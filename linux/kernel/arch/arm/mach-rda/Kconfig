## linux/kernel/arch/arm/mach-rda/Kconfig
```kconfig
if ARCH_RDA

menu "RDA SoCs Support"

config ARCH_RDA8810
	bool "RDA8810 SoC"
	select CACHE_L2X0
	help
	  RDA8810 SoC based systems

config MACH_RDA8810
	bool "RDA8810 based mach"
	select ARCH_RDA8810
	select CLKDEV_LOOKUP
	select COMMON_CLK
	select CLK_RDA
#	select COMMON_CLK_DEBUG
	help
	  RDA8810 based Board

config ARCH_RDA8810E
	bool "RDA8810E SoC"
	select ARM_GIC
	select HAVE_ARM_SCU if SMP
	select HAVE_SMP
#	select HAVE_ARM_ARCH_TIMER
#	select ARCH_NEEDS_CPU_IDLE_COUPLED if SMP
	select CPU_IDLE_MULTIPLE_DRIVERS if CPU_IDLE
	help
	  RDA8810E SoC based systems

config MACH_RDA8810E
	bool "RDA8810E based mach"
	select ARCH_RDA8810E
	select CLKDEV_LOOKUP
	select COMMON_CLK
	select CLK_RDA
#	select COMMON_CLK_DEBUG
	help
	  RDA8810E based Board

config ARCH_RDA8850E
	bool "RDA8850E SoC"
	select ARM_GIC
	select HAVE_ARM_SCU if SMP
	select HAVE_SMP
	select RDA_SLEEP_OFF_MODE
	select RDA_ISPI
	select ARM_HAS_SG_CHAIN
	select RDA_AP_PLL_FREQ_ADJUST
	help
	  RDA8850E SoC based systems

config MACH_RDA8850E
	bool "RDA8850E based mach"
	select ARCH_RDA8850E
	select CLKDEV_LOOKUP
	select COMMON_CLK
	select CLK_RDA
#	select COMMON_CLK_DEBUG
	help
	  RDA8850E based Board

config ARCH_RDA8820
	bool "RDA8820 SoC"
	select ARM_GIC
	select HAVE_ARM_SCU if SMP
	select HAVE_SMP
	help
	  RDA8820 SoC based systems

config MACH_RDA8820
	bool "RDA8820 based mach"
	select ARCH_RDA8820
	select CLKDEV_LOOKUP
	select COMMON_CLK
	select CLK_RDA
#	select COMMON_CLK_DEBUG
	help
	  RDA8820 based Board

config ARCH_RDA8810H
	bool "RDA8810H SoC"
	select ARM_GIC
	select HAVE_ARM_SCU if SMP
	select HAVE_SMP
#	select HAVE_ARM_ARCH_TIMER
#	select ARCH_NEEDS_CPU_IDLE_COUPLED if SMP
	select CPU_IDLE_MULTIPLE_DRIVERS if CPU_IDLE
	help
	  RDA8810H SoC based systems

config MACH_RDA8810H
	bool "RDA8810H based mach"
	select ARCH_RDA8810H
	select CLKDEV_LOOKUP
	select COMMON_CLK
	select CLK_RDA
#	select COMMON_CLK_DEBUG
	help
	  RDA8810H based Board

config CLK_RDA
	bool
	depends on ARCH_RDA
	help
	  RDA clock tree

config RDA_CLK_SIMU
	bool "Simulate setting h/w clock"
	depends on CLK_RDA
	help
	  Select to skip the real h/w clock settings

config RDA_FPGA
	bool "Buid for FPGA Board"
	depends on ARCH_RDA
	help
	  Select when compile for FPGA, skip all mdcom and regulator
	  operations

config RDA_SLEEP_OFF_MODE
	bool "Support shutdown CPU when sleep"
	depends on ARCH_RDA && PM
	default n
	help
	  Select if we want to shutdown/reset CPU when sleep

endmenu

endif
```

## linux/kernel/arch/arm/plat-rda/Kconfig
```kconfig
config PLAT_RDA
	bool
	depends on ARCH_RDA
	help
	  Base platform code for all RDA SoC based systems

config RDA_ISPI
	bool
	help
          Use AP ISPI3 to W/R PMU/PLL regs instead of mdsys.

config VPU_DDR_TIMING_BUG
	bool
	help
	  for VPU DDR Timing bug, lower DDR freq to 200MHZ when VPU is to open
          and restore DDR freq when vpu is closed.

config RDA_AP_PLL_FREQ_ADJUST
	bool
	help
	  for AP PLL adjust based on thermal message from modem
```

## linux/kernel/drivers/audiocontrol/Kconfig
```kconfig
menuconfig AUDIOCONTROL
	tristate "AudioControl class support"
	help
	  Say Y here to enable audio control class support. This allows
	  control audio by userspace via sysfs and uevent.
```

## linux/kernel/drivers/media/atv/Kconfig
```kconfig
#
# Multimedia Video device configuration
#

menuconfig ATV_ADAPTERS
	bool "Analog TV Adapters"
	depends on VIDEO_V4L2
	default y
	---help---
	  Say Y here to enable selecting analog tv adapters.

if ATV_ADAPTERS && VIDEO_V4L2

config ATV_RDA5888
	bool "rda5888 analog tv support"
	depends on VIDEO_V4L2
	---help---
	  This is a rda5888 analog tv driver.

endif # RADIO_ADAPTERS
```

## linux/kernel/drivers/media/platform/rda/Kconfig
```kconfig
config VIDEO_RDA
	tristate "RDA Camera Interface driver"
	depends on VIDEO_DEV && PLAT_RDA && SOC_CAMERA
	select VIDEOBUF2_DMA_CONTIG
	---help---
	  This is a v4l2 driver for the RDA Camera Interface
```

## linux/kernel/drivers/media/radio/fmradio/Kconfig
```kconfig
menuconfig FMRADIO
	tristate "FM Radio Support"
	help
	  Say Y here to enable fmradio support.

if FMRADIO

config FMRADIO_RDA599X
	tristate "RDA599X fm support"
	depends on I2C
	help
	  Say Y here to enable RDA599X fmradio support.

endif # FMRADIO
```

## linux/kernel/drivers/misc/rda/Kconfig
```kconfig
config RDA_GPADC
	tristate "RDA gpadc support"
	depends on !RDA_FPGA
	help
	  Say Y here to enable rda gpadc support.

config RDA_CALIB
	tristate "RDA calib data support"
	depends on !RDA_FPGA
	help
	  Say Y here to enable rda calib support.

config RDA_MODEM_CORE_DUMP
	tristate "RDA modem cpu core-dump"
	depends on ARCH_RDA8850E
	help
	  Say Y here to enable Core dump devices for WCPU and XCPU.
```

## linux/kernel/drivers/mtd/rnftl/Kconfig
```kconfig
config MTD_RDA_NFTL
	tristate "RNFTL (RDA NAND Flash Translation Layer) support"
	depends on BLOCK
	select MTD_BLKDEVS
	help
		rda nftl support
```

## linux/kernel/drivers/net/wireless/rdaw80211/Kconfig
```kconfig
#
# RDA599X Wireless LAN device configuration
#
menuconfig RDA_WLAN
	bool "Rda wireless(wifi bt fm) power driver and Rda wifi driver"
	---help---
		Need to enable this for RDA wifi bt fm.

if RDA_WLAN
config RDACBDEV
	bool "RdaMicro 599X Wireless Combo Chip Support"
	depends on I2C
	default n
	---help---
	  This option enables pmu support for RdaMicro 599X Wireless ComBo Chip.
	  Say Y if you want to control the chip power.

config RDAWFMAC
	tristate "Rdamicro IEEE802.11 embedded FullMac WLAN driver"
	depends on CFG80211
  	depends on RDACBDEV
	---help---
	  This module adds support for embedded wireless adapters based on
	  Rdamicro IEEE802.11bgn FullMAC chipsets. It has to work with at least
	  one of the bus interface support. If you choose to build a module,
	  it'll be called rdawfmac.ko.

if RDAWFMAC
config RDAWFMAC_WEXT
	bool "Enable WEXT support"
	depends on RDAWFMAC && CFG80211 = n
	select WIRELESS_EXT
	select WEXT_PRIV
	default n
	---help---
	  Enables WEXT support

config RDAWFMAC_SDIO
	bool "SDIO bus interface support for FullMac driver"
	depends on MMC
	depends on RDAWFMAC
	default y
	---help---
	  This option enables the SDIO bus interface support for Rdamicro
	  IEEE802.11n embedded FullMAC WLAN driver. Say Y if you want to
	  use the driver for a SDIO wireless card.

config RDAWFMAC_USB
	bool "USB bus interface support for FullMAC driver"
	depends on USB
	depends on RDAWFMAC
	default n
	---help---
	  This option enables the USB bus interface support for Rdamicro
	  IEEE802.11n embedded FullMAC WLAN driver. Say Y if you want to
	  use the driver for an USB wireless card.

config RDAWDBG
	bool "RdaMicro driver debug functions"
	depends on RDAWFMAC
	default y
	---help---
	  Selecting this enables additional code for debug purposes.
endif # RDAWFMAC

endif # RDA_WLAN
```

## linux/kernel/drivers/video/rda/Kconfig
```kconfig
config RDA_GOUDA
	tristate "RDA GOUDA support"
	depends on ARCH_RDA
	help
          RDA GOUDA.

config FB_RDA
	tristate "RDA frame buffer support"
	depends on FB && RDA_GOUDA
	select FB_CFB_FILLRECT
	select FB_CFB_COPYAREA
	select FB_CFB_IMAGEBLIT
	help
          Frame buffer driver for RDA based boards.

config FB_RDA_DBI
	depends on FB_RDA
	bool
	default y

config FB_RDA_DPI
	depends on FB_RDA
	bool
	default y

config FB_RDA_DSI
	depends on FB_RDA
	bool
	default y

config FB_UNLOCK_FOR_GOUDA_SCALAR
	tristate "set unlock mode for gouda used as scalar"
	depends on FB
	default y
	---help---
	  when Gouda is used as scalar, we need to void lock for flip.


config FB_RDA_VSYNC_ENABLE
	bool "RDA gouda vsync enable"
	depends on RDA_GOUDA
	help
	 Say Y here if you want to enable vsync.

config FB_RDA_USE_ION
	bool "RDA gouda use ION driver"
	depends on FB_RDA
	select ION_RDA
	help
	 Say Y here if you want to use ION.

config FB_RDA_DBI_BLIT_ENABLE
	bool "RDA DBI mode support"
	depends on FB_RDA
	help
	 Say Y here if you want to enable gouda blit for dbi panel.
```

## linux/kernel/sound/soc/rda/Kconfig
```kconfig
menu "Soc Audio for the RDA chips."


config SND_RDA_SOC
	tristate "SoC Audio for the RDA."
	depends on ARCH_RDA && !RDA_FPGA

config SND_RDA_SOC_RDASOUNDCARD
	tristate "rda CHIP sound card -- SoC Audio support for RAD chip."
	depends on SND_RDA_SOC
	select SND_RDA_SOC_RDASOUNDCARD_PCM
	select SND_RDA_SOC_RDASOUNDCARD_DAI
	select SND_RDA_SOC_RDASOUNDCARD_CODEC
	help
	  Say Y if you want to build in to kernel, Say M for module.

config SND_RDA_SOC_RDASOUNDCARD_PCM
	tristate

config SND_RDA_SOC_RDASOUNDCARD_DAI
	tristate

config SND_RDA_SOC_RDASOUNDCARD_CODEC
	tristate

endmenu
```

## linux/kernel/sound/soc/rdafpga/Kconfig
```kconfig
menu "Soc Audio for the RDA FPGA chips."


config SND_RDA_SOC_FPGA
	tristate "SoC Audio for the RDA FPGA"
	depends on ARCH_RDA

config SND_RDA_SOC_RDASOUNDCARD_FPGA
	tristate "rda FPGA sound card -- SoC Audio support for RAD FPGA boards."
	depends on SND_RDA_SOC_FPGA
	select SND_RDA_SOC_RDASOUNDCARD_FPGA_PCM
	select SND_RDA_SOC_RDASOUNDCARD_FPGA_DAI
	select SND_SOC_TLV320AIC23
	help
	  Say Y if you want to build in to kernel, Say M for module.

config SND_RDA_SOC_RDASOUNDCARD_FPGA_PCM
	tristate


config SND_RDA_SOC_RDASOUNDCARD_FPGA_DAI
	tristate

config SND_SOC_TLV320AIC23
	tristate


endmenu
```
